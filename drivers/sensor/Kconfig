## drivers/sensor/ezo_ec/Kconfig
```kconfig
config EZO_EC
    bool "EZO-EC Sensor"
    default n
    depends on I2C
    help
		Enable EZO-EC


config EZO_EC_EMUL
    bool "EZO-EC Emul" 
    default n
    depends on I2C_EMUL
    help
		Enable EZO-EC Emulator
```

## samples/Centralised/src/module1/Kconfig
```kconfig
menuconfig MODULE1
	bool "module1"
	default y

if MODULE1

endif # MODULE1

module = MODULE1
module-str = Module 1
source "subsys/logging/Kconfig.template.log_config"
```

## tests/button_fff/testcase.yaml
```yaml
tests:
  app.button_fff:
    platform_allow:
      - native_sim
    integration_platforms:
      - native_sim
```

## tests/ezo_ec/testcase.yaml
```yaml
tests:
  drivers.sensor.ezo_ec:
    platform_allow: native_sim
    integration_platforms:
      - native_sim
```
