## CMakeLists.txt
```
cmake_minimum_required(VERSION 3.20.0)
list(APPEND CMAKE_MODULE_PATH "$ENV{NOTUS_ROOT}/cmake")
list(APPEND DTS_PTH "$ENV{NOTUS_ROOT}/cmake")
include(Util)

ProjectSetup("standard;testing")


find_package(Zephyr REQUIRED HINTS $ENV{ZEPHYR_BASE})
project(button)

set(SOURCES 
    src/main.cpp
    src/mock.c
)

target_sources(app PRIVATE ${SOURCES})
target_include_directories(app PRIVATE src)

SetupTarget(app)

RunClangdTidy(app "${SOURCES}")
```

## prj.conf
```kconfig
CONFIG_BUTTON=y
CONFIG_GPIO_HOGS=y
CONFIG_BUTTON_LOG_LEVEL_DBG=y
```

## app.overlay
```dts
/ {
	mgpio: mock_gpio {
		compatible = "zephyr,mock-gpio";
        gpio-controller;
        #gpio-cells = <2>;
        ngpios = <1>;
    };

    zephyr,user {
        gpios = <&mgpio 0 GPIO_ACTIVE_HIGH>;
    };
};
```

## dts/bindings/zephyr,mock-gpio.yaml
```yaml
description: Mock gpio device used as stub or mock for testing

compatible: "zephyr,mock-gpio"

include: [gpio-controller.yaml, base.yaml]

gpio-cells:
  - pin
  - flags
```

## src/main.cpp
```c
#include <zephyr/drivers/gpio.h>

#include <zephyr/fff.h>
#include <zephyr/kernel.h>

#include "errors.hpp"
#include "testing.hpp"

#include "button.hpp"

#include "mock.h"

DEFINE_FFF_GLOBALS; // NOLINT

#define ZEPHYR_USER_NODE DT_PATH(zephyr_user)
#define GPIO_SPEC GPIO_DT_SPEC_GET(ZEPHYR_USER_NODE, gpios);

namespace
{

ZTEST(button, test_constructor_throw)
{
    static struct gpio_dt_spec irq_pin = GPIO_SPEC;
    irq_pin.port->state->initialized   = false;

    bool exception_caught = false;
    try
    {
        Button button(&irq_pin, K_MSEC(5));
    }
    catch (const MajorError &e)
    {
        zassert_equal(e.code(), ButtonError::gpio_is_ready);
        exception_caught = true;
    }
    catch (...)
    {
        zassert_unreachable();
    }

    zassert_true(exception_caught);

    irq_pin.port->state->initialized = true;
}

ZTEST(button, test_on_press_and_debounce)
{
    static struct gpio_dt_spec irq_pin = GPIO_SPEC;

    static struct gpio_callback *callback_data = nullptr; // NOLINT

    auto handle_callback = [](const struct device *port, struct gpio_callback *callback, bool set) -> int
    {
        ARG_UNUSED(port);
        if (set)
        {
            callback_data = callback;
        }
        else
        {
            callback_data = nullptr;
        }

        return 0;
    };

    manage_callback_mock_fake.custom_fake = handle_callback;

    atomic_t          cb_call_count    = ATOMIC_INIT(0);
    auto              cb_test2         = [&]() { atomic_inc(&cb_call_count); };
    const k_timeout_t debounce_time_ms = K_MSEC(5);
    Button            button(&irq_pin, debounce_time_ms);

    zassert_equal(pin_configure_mock_fake.call_count, 1);
    zassert_equal(pin_interrupt_configure_mock_fake.call_count, 1);
    zassert_equal(manage_callback_mock_fake.call_count, 1);

    button.add_on_press_callback(cb_test2);

    auto debounce_sim = [](int total_debounce_time_ms)
    {
        for (int i = 0; i < total_debounce_time_ms; i++)
        {
            if (callback_data != nullptr)
            {
                callback_data->handler(nullptr, callback_data, 0);
            }

            k_sleep(K_MSEC(1));

            if (callback_data != nullptr)
            {
                callback_data->handler(nullptr, callback_data, 0);
            }
        }
    };

    constexpr int estimate_debounce_time_ms = 5;
    debounce_sim(estimate_debounce_time_ms);

    zassert_equal(atomic_get(&cb_call_count), 1);
}

void my_suite_before(void *fixture)
{
    ARG_UNUSED(fixture);
    static struct gpio_dt_spec irq_pin = GPIO_SPEC;
    gpio_pin_configure_dt(&irq_pin, GPIO_INPUT);
    RESET_FAKE(pin_configure_mock);
    RESET_FAKE(port_get_raw_mock);
    RESET_FAKE(port_set_masked_raw_mock);
    RESET_FAKE(port_set_bits_raw_mock);
    RESET_FAKE(port_clear_bits_raw_mock);
    RESET_FAKE(port_toggle_bits_mock);
    RESET_FAKE(pin_interrupt_configure_mock);
    RESET_FAKE(manage_callback_mock);
    RESET_FAKE(get_pending_int_mock);
}

ZTEST_SUITE(button, nullptr, nullptr, my_suite_before, nullptr, nullptr); // NOLINT

} // namespace
```

## src/mock.c
```c
#include <zephyr/device.h>
#include <zephyr/drivers/gpio.h>

#include "mock.h"

#define DT_DRV_COMPAT zephyr_mock_gpio

// NOLINTBEGIN
DEFINE_FAKE_VALUE_FUNC(int, pin_configure_mock, const struct device *, gpio_pin_t, gpio_flags_t);
DEFINE_FAKE_VALUE_FUNC(int, port_get_raw_mock, const struct device *, gpio_port_value_t *);
DEFINE_FAKE_VALUE_FUNC(int, port_set_masked_raw_mock, const struct device *, gpio_port_pins_t, gpio_port_value_t);
DEFINE_FAKE_VALUE_FUNC(int, port_set_bits_raw_mock, const struct device *, gpio_port_pins_t);
DEFINE_FAKE_VALUE_FUNC(int, port_clear_bits_raw_mock, const struct device *, gpio_port_pins_t);
DEFINE_FAKE_VALUE_FUNC(int, port_toggle_bits_mock, const struct device *, gpio_port_pins_t);
DEFINE_FAKE_VALUE_FUNC(int,
                       pin_interrupt_configure_mock,
                       const struct device *,
                       gpio_pin_t,
                       enum gpio_int_mode,
                       enum gpio_int_trig);
DEFINE_FAKE_VALUE_FUNC(int, manage_callback_mock, const struct device *, struct gpio_callback *, bool);
DEFINE_FAKE_VALUE_FUNC(uint32_t, get_pending_int_mock, const struct device *);
// NOLINTEND

static const struct gpio_driver_api mock_gpio_api = {
    .pin_configure           = pin_configure_mock,
    .port_get_raw            = port_get_raw_mock,
    .port_set_masked_raw     = port_set_masked_raw_mock,
    .port_set_bits_raw       = port_set_bits_raw_mock,
    .port_clear_bits_raw     = port_clear_bits_raw_mock,
    .port_toggle_bits        = port_toggle_bits_mock,
    .pin_interrupt_configure = pin_interrupt_configure_mock,
    .manage_callback         = manage_callback_mock,
    .get_pending_int         = get_pending_int_mock,
};

// NOLINTBEGIN
struct gpio_driver_config config = {
    .port_pin_mask = 0xFF,

};

struct gpio_driver_data data = {
    .invert = 0x00,
};

DEVICE_DT_INST_DEFINE(0, NULL, NULL, &data, &config, POST_KERNEL, CONFIG_GPIO_INIT_PRIORITY, &mock_gpio_api);
// NOLINTEND
```

## src/mock.h
```c
#pragma once

#include <zephyr/drivers/gpio.h>
#include <zephyr/fff.h>

#ifdef __cplusplus
extern "C"
{
#endif

    // NOLINTBEGIN(cppcoreguidelines-avoid-non-const-global-variables)
    DECLARE_FAKE_VALUE_FUNC(int, pin_configure_mock, const struct device *, gpio_pin_t, gpio_flags_t);
    DECLARE_FAKE_VALUE_FUNC(int, port_get_raw_mock, const struct device *, gpio_port_value_t *);
    DECLARE_FAKE_VALUE_FUNC(int, port_set_masked_raw_mock, const struct device *, gpio_port_pins_t, gpio_port_value_t);
    DECLARE_FAKE_VALUE_FUNC(int, port_set_bits_raw_mock, const struct device *, gpio_port_pins_t);
    DECLARE_FAKE_VALUE_FUNC(int, port_clear_bits_raw_mock, const struct device *, gpio_port_pins_t);
    DECLARE_FAKE_VALUE_FUNC(int, port_toggle_bits_mock, const struct device *, gpio_port_pins_t);
    DECLARE_FAKE_VALUE_FUNC(int,
                            pin_interrupt_configure_mock,
                            const struct device *,
                            gpio_pin_t,
                            enum gpio_int_mode,
                            enum gpio_int_trig);
    DECLARE_FAKE_VALUE_FUNC(int, manage_callback_mock, const struct device *, struct gpio_callback *, bool);
    DECLARE_FAKE_VALUE_FUNC(uint32_t, get_pending_int_mock, const struct device *);
    // NOLINTEND(cppcoreguidelines-avoid-non-const-global-variables)

#ifdef __cplusplus
}
#endif
```
