## CMakeLists.txt
```
list(APPEND CMAKE_MODULE_PATH "$ENV{NOTUS_ROOT}/cmake")

include(Util)
include(Sys)


if(NOT CONFIG_RUST) 
    create_notus_lib()
    zephyr_include_directories(include)
    RunClangdTidy(notus_lib "${NOTUS_LIB_SAUCES}")
endif()

add_subdirectory(subsys)
add_subdirectory(drivers)
```

## Kconfig
```
menu "Zephyr Playground"

rsource "subsys/Kconfig"

endmenu
```

## west.yml
```
manifest:
  remotes:
    - name: zephyrproject-rtos
      url-base: https://github.com/zephyrproject-rtos
    - name: Neargye 
      url-base: https://github.com/Neargye
    - name: TartanLlama 
      url-base: https://github.com/TartanLlama
    - name: embedded-template-library 
      url-base: https://github.com/ETLCPP
  projects:
    - name: zephyr
      remote: zephyrproject-rtos
      revision: v4.1.0
      import:
        # By using name-allowlist we can clone only the modules that are
        # strictly needed
        name-allowlist:
          - cmsis      # required by the ARM port
          - hal_nordic # required for Nordic
          - littlefs   # required for file system
          - zephyr-lang-rust
    - name: magic_enum
      remote: Neargye
      revision: v0.9.5
    - name: expected
      remote: TartanLlama
      revision: v1.1.0
    - name: optional
      remote: TartanLlama
      revision: v1.1.0
    - name: etl
      remote: embedded-template-library 
      revision: 20.38.10
  self:
    path: notus
```

## prj.conf
```kconfig
# CPP
CONFIG_CPP=y
CONFIG_REQUIRES_FULL_LIBCPP=y
CONFIG_STD_CPP20=y

CONFIG_NO_OPTIMIZATIONS=y
CONFIG_DEBUG=y
```

## dts/bindings/sensor/atlas,ezo-ec.yaml
```yaml
description: |
    Sensor

compatible: "atlas,ezo-ec"

include: ["i2c-device.yaml", "sensor-device.yaml"]

properties:
```

## src/main.cpp
```c
#include <iostream>

#include <zephyr/kernel.h>

#if defined(CONFIG_SOC_POSIX)
#include "posix_board_if.h"
#endif


int main(void)
{
    std::cout << "Hello, C++ world! " << CONFIG_BOARD << '\n';

#if defined(CONFIG_SOC_POSIX)
    posix_exit(0);
#endif
    return 0;
}
```

## include/button.hpp
```c
#pragma once

#include <functional>
#include <system_error>

#include "zephyr/drivers/gpio.h"
#include "zephyr/kernel.h"
#include "zephyr/sys_clock.h"

#include "uptime_tp.hpp"

enum class ButtonError
{
    gpio_is_ready = 1,
    pin_configuration,
    interrupt_configuration,
    add_callback,
};

namespace std
{
  template <>
    struct is_error_code_enum<ButtonError> : true_type {};
}

std::error_code make_error_code(ButtonError);

class IButton
{
  public:
    IButton() = default;
    virtual ~IButton() = default;
    virtual auto add_on_press_callback(std::function<void(void)> callback) -> void = 0;

    IButton(const IButton &other) = delete;
    IButton(IButton&& other) noexcept = delete;
    IButton& operator=(const IButton &other) = delete;
    IButton& operator=(IButton&& other) noexcept = delete;
    
};

class Button final : public IButton
{
  public:
    Button() = delete;
    explicit Button(gpio_dt_spec *spec, k_timeout_t debounce_time);
    auto add_on_press_callback(std::function<void(void)> callback) -> void final;

    Button(const Button &other) = delete;
    Button(Button&& other) noexcept = delete;
    Button& operator=(const Button &other) = delete;
    Button &operator=(Button &&other) noexcept = delete;

    ~Button() final;
        
    struct CallbackContainer
    {
        gpio_callback cb_data{};
        Button *self{};
    };

    friend void zephyr_callback(const struct device *port, struct gpio_callback *callback,
                                       gpio_port_pins_t pins);
    friend void timer_expiry_func(struct k_timer *timer);

  private:
    auto gpio_handler() -> void;
    gpio_dt_spec *_spec;
    CallbackContainer _cb_data;
    k_timeout_t       _debounce_time;

    std::chrono::time_point<UpTime> _start_tp;

    k_timer _debounce_timer{};
    std::function<void(void)> _on_press_callback;
};
```

## include/errors.hpp
```c
#pragma once

#include <chrono>
#include <source_location>
#include <system_error>
#include <array>

#include "logging.hpp"
#include "uptime_tp.hpp"

class MajorError
{
  public:
    MajorError() = delete;
    explicit MajorError(std::error_code code, int err_no,
                        const std::source_location &loc = std::source_location::current())
        : _code{code}, _err_no{err_no}, _location{loc}
    {
        std::chrono::duration time_elapsed = UpTime::now().time_since_epoch();
        std::chrono::hh_mm_ss formatted_time{time_elapsed};
        uint32_t              microseconds = formatted_time.subseconds().count();
        constexpr int         microseconds_in_millisecond = 1000;
        constexpr int         milliseconds_in_seconds     = 1000;
        uint32_t milliseconds = microseconds / microseconds_in_millisecond;
        microseconds %= microseconds_in_millisecond;
        milliseconds %= milliseconds_in_seconds;

        std::array<char, 20> timestamp{};
        (void)std::snprintf(timestamp.data(), sizeof(timestamp), "[%02llu:%02llu:%02llu.%03u,%03u]", formatted_time.hours().count(), formatted_time.minutes().count(), formatted_time.seconds().count(), milliseconds, microseconds);

        LOG_PRINTK("\e[1;45m%s <exception>: %s:%d:%d - %s:%s:%d\e[0m\n", timestamp.data(), loc.file_name(), loc.line(), loc.column(), _code.category().name(), _code.message().c_str(), _err_no);
    }

    [[nodiscard]] std::error_code code() const {return _code;}
    [[nodiscard]] int err_no() const {return _err_no;}
    [[nodiscard]] std::source_location where()const {return _location;}

  private:
    std::error_code _code;
    int _err_no;
    std::source_location _location;
};
```

## include/etl_profile.h
```c
#ifndef ETL_PROFILE_H
#define ETL_PROFILE_H

#define ETL_THROW_EXCEPTIONS
#define ETL_VERBOSE_ERRORS
#define ETL_USING_CPP17

#endif
```

## include/file_system.hpp
```c
#pragma once
#include <span>
#include <system_error>
#include <type_traits>

#include <etl/string_view.h>
#include <etl/unordered_map.h>
#include <tl/expected.hpp>

#pragma GCC diagnostic push
#pragma GCC diagnostic ignored "-Wmissing-field-initializers"
#pragma GCC diagnostic ignored "-Wshadow"
#include <zephyr/fs/fs.h>
#pragma GCC diagnostic pop

enum class FileSystemError
{
    invalid_arg = 1,
    already_mounted,
    fs_type_not_supported,
    fs_type_not_registered,
    invalid_filename,
    busy,
    path_is_directory,
    file_not_at_path,
    bad_data,
    uncompleted_write,
    uncompleted_read,
    fs_not_available,
    operation_not_supported,
    file_not_open_for_write,
    file_not_open_for_read,
    unknown,
};

namespace std
{
template <> struct is_error_code_enum<FileSystemError> : true_type
{
};
} // namespace std

std::error_code make_error_code(FileSystemError);

class ZFileSystem;

class ZFile
{
  public:
    friend class ZFileSystem;
    enum class Flags : fs_mode_t
    {
        Read           = FS_O_READ,
        Write          = FS_O_WRITE,
        Read_and_Write = FS_O_RDWR,
        Create         = FS_O_CREATE,
        Append         = FS_O_APPEND,
    };
    friend Flags operator&(const Flags &lhs, const Flags &rhs);
    friend Flags operator|(const Flags &lhs, const Flags &rhs);

    void write(std::span<uint8_t> data);
    void read(std::span<uint8_t> data);

    ~ZFile();

    ZFile()                              = delete;
    ZFile(const ZFile &other)            = delete;
    ZFile(ZFile &&other)                 = delete;
    ZFile &operator=(const ZFile &other) = delete;
    ZFile &operator=(ZFile &&other)      = delete;

  private:
    ZFile(const etl::string_view &file_name, const ZFile::Flags flags, const etl::string_view &mount);
    static tl::expected<fs_file_t, FileSystemError> open_file(const etl::string_view &file_name,
                                                              const fs_mode_t         flags,
                                                              const etl::string_view &mount);

    struct fs_file_t _file
    {
    };
};

class ZFileSystem
{
  public:
    explicit ZFileSystem(struct fs_mount_t *mount);
    [[nodiscard]] ZFile open_file(const etl::string_view &file_name, const ZFile::Flags flags);
    bool                check_file_exists(const etl::string_view &file_name);

    ~ZFileSystem();

    ZFileSystem(const ZFileSystem &other)            = delete;
    ZFileSystem(ZFileSystem &&other)                 = delete;
    ZFileSystem &operator=(const ZFileSystem &other) = delete;
    ZFileSystem &operator=(ZFileSystem &&other)      = delete;

  private:
    struct fs_mount_t *_mount;
};
```

## include/logging.hpp
```c
#pragma once

#include <zephyr/logging/log_core.h>
#include <zephyr/logging/log.h>

/*

This header file is to wrap all the logging macros with // NOLINT to get rid of clang-tidy warnings that we can't avoid.
As this is done at the preprocessor level this shouldn't have any effect on performance.
*/

#undef Z_LOG
#define Z_LOG(_level, ...)                                                                                             \
     Z_LOG2(_level, 0, Z_LOG_CURRENT_DATA(), __VA_ARGS__) // NOLINT

#undef LOG_PRINTK
#define LOG_PRINTK(...) Z_LOG_PRINTK(0, __VA_ARGS__) // NOLINT

#undef LOG_MODULE_REGISTER
#define LOG_MODULE_REGISTER(...)                                                                                       \
    COND_CODE_1(Z_DO_LOG_MODULE_REGISTER(__VA_ARGS__),                                                                 \
                (_LOG_MODULE_DATA_CREATE(GET_ARG_N(1, __VA_ARGS__), _LOG_LEVEL_RESOLVE(__VA_ARGS__))), ())             \
    LOG_MODULE_DECLARE(__VA_ARGS__) // NOLINT



#undef LOG_MODULE_DECLARE
#define LOG2_MODULE_DECLARE(...)                                                                                       \
    extern const struct log_source_const_data Z_LOG_ITEM_CONST_DATA(GET_ARG_N(1, __VA_ARGS__));                        \
    extern struct log_source_dynamic_data     LOG_ITEM_DYNAMIC_DATA(GET_ARG_N(1, __VA_ARGS__));                        \
                                                                                                                       \
    static const struct log_source_const_data *__log_current_const_data __unused =                                     \
        Z_DO_LOG_MODULE_REGISTER(__VA_ARGS__) ? &Z_LOG_ITEM_CONST_DATA(GET_ARG_N(1, __VA_ARGS__)) : NULL;              \
                                                                                                                       \
    static struct log_source_dynamic_data *__log_current_dynamic_data __unused =                                       \
        (Z_DO_LOG_MODULE_REGISTER(__VA_ARGS__) && IS_ENABLED(CONFIG_LOG_RUNTIME_FILTERING))                            \
            ? &LOG_ITEM_DYNAMIC_DATA(GET_ARG_N(1, __VA_ARGS__))                                                        \
            : NULL;                                                                                                    \
                                                                                                                       \
    static const uint32_t __log_level __unused = _LOG_LEVEL_RESOLVE(__VA_ARGS__)


#define LOG_MODULE_DECLARE(...) LOG2_MODULE_DECLARE(__VA_ARGS__) // NOLINT	
```

## include/stopwatch.hpp
```c
#pragma once

#include <chrono>

#include "uptime_tp.hpp"

class IStopwatch
{
	public:
        virtual ~IStopwatch() = default;

        virtual auto start() -> void = 0;
        virtual auto pause() -> void = 0;
        virtual auto reset() -> void = 0;
        virtual auto get_time() -> std::chrono::milliseconds = 0;
};


class Stopwatch : public IStopwatch
{
	public:
        Stopwatch() = default;
        auto start() -> void final;
        auto pause() -> void final;
        auto reset() -> void final;
	    auto get_time() -> std::chrono::milliseconds final;

	  private:
	    std::chrono::time_point<UpTime> _start_tp;
	    std::chrono::microseconds _time_before_pause{0};
	    bool _is_paused = false;
};
```

## include/testing.hpp
```c
#pragma once


#include <zephyr/ztest.h>


// ztest_assert.h
#undef zassert_ok
#define zassert_ok(cond, ...) zassert(!(cond), #cond " is non-zero", ##__VA_ARGS__) // NOLINT

#undef zassert_not_ok
#define zassert_not_ok(cond, ...) zassert(!!(cond), #cond " is zero", ##__VA_ARGS__) // NOLINT

#undef zassert_unreachable
#define zassert_unreachable(...) zassert(0, "Reached unreachable code", ##__VA_ARGS__) // NOLINT

#undef zassert_true
#define zassert_true(cond, ...) zassert(cond, #cond " is false", ##__VA_ARGS__) // NOLINT

#undef zassert_equal
#define zassert_equal(a, b, ...) zassert((a) == (b), #a " not equal to " #b, ##__VA_ARGS__) // NOLINT

#undef zassert_false
#define zassert_false(cond, ...) zassert(!(cond), #cond " is true", ##__VA_ARGS__) // NOLINT

#undef zassert_within
#define zassert_within(a, b, d, ...) zassert(((a) >= ((b) - (d))) && ((a) <= ((b) + (d))), #a " not within " #b " +/- " #d, ##__VA_ARGS__) // NOLINT

// ztest_test_new.h
#undef ZTEST
#define ZTEST(suite, fn) Z_ZTEST(suite, fn, 0) // NOLINT
```

## include/uptime_tp.hpp
```c
#pragma once
#include <chrono>
#include <cstdint>

#include "zephyr/kernel.h"

struct UpTime
{
    using duration   = std::chrono::microseconds;
    using rep        = duration::rep;
    using period     = duration::period;
    using time_point = std::chrono::time_point<UpTime>;
    static constexpr bool is_steady = true;

    static time_point now() noexcept
    {
        using namespace std::chrono;
        auto microseconds_per_second = duration_cast<microseconds>(seconds(1));
        const auto microseconds_passed = std::chrono::microseconds(k_uptime_ticks() * microseconds_per_second.count() / CONFIG_SYS_CLOCK_TICKS_PER_SEC);
        return time_point{microseconds_passed};
    }
};
```

## src/button.cpp
```c
#include <cassert>
#include <chrono>

#include <zephyr/drivers/gpio.h>

#include "errors.hpp"
#include "logging.hpp"
#include "button.hpp"
#include "uptime_tp.hpp"

LOG_MODULE_REGISTER(button, LOG_LEVEL_DBG);

void timer_expiry_func(struct k_timer *timer)
{
    LOG_DBG("Enter");

    auto *self = static_cast<Button *>(k_timer_user_data_get(timer));

    gpio_pin_interrupt_configure_dt(self->_spec, GPIO_INT_EDGE_BOTH);
    gpio_add_callback_dt(self->_spec, &self->_cb_data.cb_data);

    if (self->_on_press_callback)
    {
        LOG_DBG("Calling on_press_callback"); 
        self->_on_press_callback();
    }

    LOG_DBG("Exit"); 
}

void zephyr_callback(const struct device *port, struct gpio_callback *callback, gpio_port_pins_t pins)
{
    ARG_UNUSED(port);
    ARG_UNUSED(pins);
    ARG_UNUSED(callback);

    LOG_DBG("Enter");


    auto *data = CONTAINER_OF(callback, Button::CallbackContainer, cb_data); // NOLINT
    Button *self = data->self;

    self->gpio_handler();

    LOG_DBG("Exit"); 
}

void Button::gpio_handler()
{
    LOG_DBG("Enter"); 
    if (k_timer_status_get(&_debounce_timer) == 0)
    {
        LOG_DBG("Handle Debounce"); 
        gpio_pin_interrupt_configure_dt(_spec, GPIO_INT_DISABLE);
        gpio_remove_callback_dt(_spec, &_cb_data.cb_data);
        gpio_pin_configure_dt(_spec, GPIO_INPUT);
        k_timer_start(&_debounce_timer, _debounce_time, K_NO_WAIT);
        _start_tp = UpTime::now();
    }
    LOG_DBG("Exit"); 
}


Button::Button(gpio_dt_spec *spec, k_timeout_t debounce_time)
    : _spec{spec},
      _debounce_time{debounce_time}
{
    int ret = 0;
    assert(spec != nullptr);

    if (!gpio_is_ready_dt(_spec))
    {
        throw MajorError(ButtonError::gpio_is_ready, 0);
    }

    ret = gpio_pin_configure_dt(_spec, GPIO_INPUT);
    if (ret != 0) 
    {
        throw MajorError(ButtonError::pin_configuration, ret);
    }

    ret = gpio_pin_interrupt_configure_dt(_spec, GPIO_INT_EDGE_BOTH);
    if (ret != 0) 
    {
        throw MajorError(ButtonError::interrupt_configuration, ret);
    }

    k_timer_init(&_debounce_timer, timer_expiry_func, nullptr);
    k_timer_user_data_set(&_debounce_timer, static_cast<void *>(this));

    _cb_data.self   = this;

    gpio_init_callback(&_cb_data.cb_data, zephyr_callback, BIT(_spec->pin));
    ret = gpio_add_callback_dt(_spec, &_cb_data.cb_data);
    if (ret != 0) 
    {
        throw MajorError(ButtonError::add_callback, ret);
    }

}

auto Button::add_on_press_callback(std::function<void(void)> callback) -> void
{
    _on_press_callback = callback;
}

Button::~Button()
{
    gpio_pin_interrupt_configure_dt(_spec, GPIO_INT_MODE_DISABLED); 
    gpio_remove_callback_dt(_spec, &_cb_data.cb_data);
}
```

## src/button_error.cpp
```c
#include <magic_enum.hpp>

#include "button.hpp"
   
namespace { // anonymous namespace
    
struct ButtonErrorCategory : std::error_category
{
  [[nodiscard]] const char* name() const noexcept override;
  [[nodiscard]] std::string message(int err_value) const override;
};
    
const char* ButtonErrorCategory::name() const noexcept
{
  return "Button";
}
    
std::string ButtonErrorCategory::message(int err_value) const {
    auto error = static_cast<ButtonError>(err_value);
    std::string_view errorName = magic_enum::enum_name(error);

    if (errorName.empty()) {
        return "(unrecognized error)";
    }

    return std::string(errorName);
}
 
const ButtonErrorCategory theButtonErrorCategory {};
    
} // anonymous namespace
   
std::error_code make_error_code(ButtonError err)
{
  return {static_cast<int>(err), theButtonErrorCategory};
}
 
```

## src/display.cpp
```c
#include <zephyr/drivers/display.h>
#include <zephyr/kernel.h>
#include <zephyr/device.h>

#include "logging.hpp"

#include "display.hpp"

LOG_MODULE_REGISTER(display, LOG_LEVEL_DBG);

// Very placeholder implementation

void Display::set_weight_grams(double weight_grams)
{
    LOG_DBG("Weight: %.2fg", weight_grams);
}


void Display::set_time(std::chrono::milliseconds milliseconds)
{
    auto total_seconds = std::chrono::duration_cast<std::chrono::seconds>(milliseconds);
    int total_seconds_count = static_cast<int>(total_seconds.count());

    constexpr int seconds_in_min = std::chrono::seconds(std::chrono::minutes(1)).count();
    int minutes = total_seconds_count / seconds_in_min;
    int seconds = total_seconds_count % seconds_in_min;

    // Output in "MM:SS" format
    LOG_DBG("%02d:%02d\n", minutes, seconds);
}
```

## src/file_system_error.cpp
```c
#include <magic_enum.hpp>

#include "file_system.hpp"
   
namespace { // anonymous namespace
    
struct FileSystemErrorCategory : std::error_category
{
  [[nodiscard]] const char* name() const noexcept override;
  [[nodiscard]] std::string message(int err_value) const override;
};
    
const char* FileSystemErrorCategory::name() const noexcept
{
  return "file system";
}
    
std::string FileSystemErrorCategory::message(int err_value) const {
    auto error = static_cast<FileSystemError>(err_value);
    std::string_view errorName = magic_enum::enum_name(error);

    if (errorName.empty()) {
        return "(unrecognized error)";
    }

    return std::string(errorName);
}
 
const FileSystemErrorCategory theFileSystemErrorCategory {};
    
} // anonymous namespace
   
std::error_code make_error_code(FileSystemError err)
{
  return {static_cast<int>(err), theFileSystemErrorCategory};
}
 
```
