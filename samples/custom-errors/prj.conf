## CMakeLists.txt
```
cmake_minimum_required(VERSION 3.20.0)
list(APPEND CMAKE_MODULE_PATH "$ENV{NOTUS_ROOT}/cmake")
include(Util)

ProjectSetup("standard")

find_package(Zephyr REQUIRED HINTS $ENV{ZEPHYR_BASE})
project(status_code)

set(SOURCES 
    src/main.cpp
)

target_sources(app PRIVATE ${SOURCES})
SetupTarget(app)
```

## prj.conf
```kconfig
CONFIG_ASSERT=y

CONFIG_CPP_EXCEPTIONS=n
```

## src/main.cpp
```c
#include <cassert>
#include <zephyr/kernel.h>
#include <iostream>

#include "custom_errors.hpp"

// Define your error enums
enum class NetworkError
{
    ConnectionFailed,
    Timeout,
    InvalidAddress
};

enum class FileError
{
    NotFound,
    PermissionDenied,
    DiskFull
};

enum class Servity
{
    Major,
    Minor
};

// Define a concrete domain for NetworkError
class network_error_domain : public error_domain<NetworkError>
{
  public:
    constexpr network_error_domain() noexcept : error_domain<NetworkError>("network")
    {
    }

    constexpr std::string_view get_message(NetworkError code) const noexcept override
    {
        switch (code)
        {
        case NetworkError::ConnectionFailed:
            return "Connection failed";
        case NetworkError::Timeout:
            return "Connection timed out";
        case NetworkError::InvalidAddress:
            return "Invalid address";
        default:
            return "Unknown network error";
        }
    }

    // template<>
    // constexpr bool equivlent(const Servity &lhs, const error_code &rhs)
    // {
    //     auto err = static_cast<NetworkError>(rhs.value());
    //     switch (lhs)
    //     {
    //         case Servity::Major: {
    //             return NetworkError::ConnectionFailed == err ||
    //                     NetworkError::Timeout == err;
    //         }
    //         case Servity::Minor: {
    //                 return NetworkError::InvalidAddress == err;
    //         }
    //     }
    // }
};

const network_error_domain network_domain{};

constexpr error_code make_error_code(NetworkError err)
{
    return {err, network_domain};
}

class file_error_domain : public error_domain<FileError>
{
  public:
    constexpr file_error_domain() noexcept : error_domain<FileError>("file")
    {
    }

    constexpr std::string_view get_message(FileError code) const noexcept override
    {
        switch (code)
        {
        case FileError::NotFound:
            return "File not found";
        case FileError::PermissionDenied:
            return "Permission denied";
        case FileError::DiskFull:
            return "Disk is full";
        default:
            return "Unknown file error";
        }
    }    
};

const file_error_domain file_domain{};

constexpr error_code make_error_code(FileError err)
{
    return {err, file_domain};
}

// Usage
int main()
{
    printk("Here\n");
    
    error_code ec1 = make_error_code(NetworkError::Timeout);
    error_code ec2 = make_error_code(FileError::NotFound);

    std::cout << "Error: " << ec1.message() << " from domain: " << ec1.domain().name() << std::endl;

    

    return 0;
}
```

## src/custom_errors.hpp
```c
#pragma once

#include <compare>
#include <concepts>
#include <string_view>
#include <type_traits>
#include <iostream>

// Forward declarations
class error_code;

// Concept for valid error code enums
template <typename E>
concept ErrorEnum = std::is_enum_v<E>;
template <ErrorEnum E> class error_domain;

// Base error domain interface - this is our "domain" concept
class error_domain_base
{
  public:
    virtual ~error_domain_base()                                                                 = default;
    virtual constexpr std::string_view name() const noexcept                                     = 0;
    virtual constexpr std::string_view message(int code) const noexcept                          = 0;
    virtual constexpr bool             equivalent(const error_code &lhs, int rhs) const noexcept = 0;
    virtual constexpr bool             equivalent(int lhs, const error_code &rhs) const noexcept = 0;
};

// Main error_code class
class error_code
{
  private:
    int                      m_value{0};
    const error_domain_base *m_domain{nullptr};

  public:
    constexpr error_code() noexcept = default;

    template <ErrorEnum E>
    constexpr error_code(E e, const error_domain<E> &domain) noexcept : m_value(static_cast<int>(e)), m_domain(&domain)
    {
    }

    constexpr int value() const noexcept
    {
        return m_value;
    }
    constexpr const error_domain_base &domain() const noexcept
    {
        return *m_domain;
    }

    constexpr std::string_view message() const noexcept
    {
        return m_domain != nullptr ? m_domain->message(m_value) : "No error";
    }

    constexpr explicit operator bool() const noexcept
    {
        return m_value != 0;
    }

    constexpr friend bool operator==(const error_code &lhs, const error_code &rhs) noexcept
    {
        return lhs.m_value == rhs.m_value && lhs.m_domain == rhs.m_domain;
    }

    template <ErrorEnum E> constexpr friend bool operator==(const error_code &lhs, E rhs) noexcept
    {
        return lhs.m_domain && lhs.m_domain->equivalent(lhs, static_cast<int>(rhs));
    }

    constexpr auto operator<=>(const error_code &) const = default;
};

// Concrete error domain for specific enums
template <ErrorEnum E> class error_domain : public error_domain_base
{
  private:
    std::string_view m_name;

  public:
    constexpr explicit error_domain(const std::string_view name) noexcept : m_name(name)
    {

    }
    constexpr std::string_view name() const noexcept override
    {
        return m_name;
    }

    constexpr std::string_view message(int code) const noexcept override
    {
        return get_message(static_cast<E>(code));
    }

    constexpr bool equivalent(const error_code &lhs, int rhs) const noexcept override
    {
        return &lhs.domain() == this && lhs.value() == rhs;
    }

    constexpr bool equivalent(int lhs, const error_code &rhs) const noexcept override
    {
        return &rhs.domain() == this && rhs.value() == lhs;
    }

    // This is the method that domain implementers need to provide
    constexpr virtual std::string_view get_message(E code) const noexcept = 0;
};
```
