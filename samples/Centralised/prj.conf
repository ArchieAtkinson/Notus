## CMakeLists.txt
```
cmake_minimum_required(VERSION 3.20.0)
list(APPEND CMAKE_MODULE_PATH "$ENV{NOTUS_ROOT}/cmake")
include(Util)

ProjectSetup("standard")

find_package(Zephyr REQUIRED HINTS $ENV{ZEPHYR_BASE})
project(centralized)

set(SOURCES 
    src/main.cpp
)

target_sources(app PRIVATE ${SOURCES})

target_compile_options(app PUBLIC -Wno-missing-field-initializers)

add_subdirectory(src/module1)

target_include_directories(app PRIVATE include)

SetupTarget(app)
```

## KConfig
```
rsource "src/module1/Kconfig"

menu "Zephyr Kernel"

source "Kconfig.zephyr"

endmenu

module = APPLICATION
module-str = Application
source "subsys/logging/Kconfig.template.log_config"
```

## Kconfig
```
menu "Zephyr Kernel"
    source "Kconfig.zephyr"
endmenu

module = APPLICATION
module-str = Application
source "subsys/logging/Kconfig.template.log_config"

rsource "src/module1/Kconfig"
```

## prj.conf
```kconfig
CONFIG_DEBUG=y

CONFIG_LOG=y

CONFIG_MAIN_STACK_SIZE=4096

CONFIG_APPLICATION_LOG_LEVEL_INF=y
CONFIG_MODULE1_LOG_LEVEL_INF=y

CONFIG_ZBUS=y
CONFIG_ZBUS_CHANNEL_NAME=y
CONFIG_ZBUS_OBSERVER_NAME=y
CONFIG_ZBUS_RUNTIME_OBSERVERS=y
```

## src/main.cpp
```c
#include <posix_board_if.h>
#include <zephyr/kernel.h>

#include "logging.hpp"
#include "util.hpp"

#include "module1/messages.hpp"

LOG_MODULE_REGISTER(APPLICATION, CONFIG_APPLICATION_LOG_LEVEL);

K_MSGQ_DEFINE(in, sizeof(module1::module1_out_msgs), 10, 1);   // NOLINT

bool print_channel_data_iterator(const struct zbus_channel *chan,
                                 void                      *user_data)
{
    auto *count = static_cast<int *>(user_data);

    LOG_INF("%d - Channel %s:", *count, zbus_chan_name(chan));
    LOG_INF("      Message size: %d", zbus_chan_msg_size(chan));
    LOG_INF("      Observers:");

    
    ++(*count);

    struct zbus_channel_observation *observation = nullptr;

    for (int16_t i     = chan->data->observers_start_idx,
                 limit = chan->data->observers_end_idx;
         i < limit; ++i)
    {
        STRUCT_SECTION_GET(zbus_channel_observation, i, &observation);  // NOLINT

        __ASSERT(observation != nullptr, "observation must be not NULL");  // NOLINT

        LOG_INF("      - %s", observation->obs->name);
    }

    struct zbus_observer_node *obs_nd = nullptr;
    struct zbus_observer_node *tmp    = nullptr;

    SYS_SLIST_FOR_EACH_CONTAINER_SAFE(&chan->data->observers, obs_nd, tmp, node) // NOLINT
    {
        LOG_INF("      - %s", obs_nd->obs->name);
    }

    return true;
}

bool print_observer_data_iterator(const struct zbus_observer *obs,
                                  void                       *user_data)
{
    auto *count = static_cast<int *>(user_data);

    LOG_INF("%d - %s %s", *count,
            obs->type == ZBUS_OBSERVER_LISTENER_TYPE ? "Listener"
                                                     : "Subscriber",
            zbus_obs_name(obs));

    ++(*count);

    return true;
}

int main()
{
    using namespace module1;
    LOG_INF("Hello World");

    LOG_INF("Channel list:");
    int count = 0;
    zbus_iterate_over_channels_with_user_data(print_channel_data_iterator,
                                              &count);

    LOG_INF("Observers list:");
    count = 0;
    zbus_iterate_over_observers_with_user_data(print_observer_data_iterator,
                                               &count);

    while (true)
    {
        LOG_INF("Send to out");
        module1::module1_in_msgs msg_out = module1::module1_in_msg_a{1};
        send_message<module1_in_msgs>(&module1_in_chan, msg_out, K_NO_WAIT);
        k_msleep(500); // NOLINT(cppcoreguidelines-avoid-magic-numbers)

        LOG_INF("Getting in");
        module1::module1_out_msgs msg_in{};
        k_msgq_get(&in, &msg_in, K_FOREVER);
        LOG_INF("%s", std::get<0>(msg_in).value.data());
        k_msleep(500); // NOLINT(cppcoreguidelines-avoid-magic-numbers)
    }

    k_sleep(K_FOREVER);
}

static void listener_callback(const struct zbus_channel *chan)  // NOLINT
{
    if (&module1_out_chan == chan)
    {
        LOG_INF("Adding to Queue");
        add_to_queue<module1::module1_out_msgs>(chan, &in, K_FOREVER);
    }
}

ZBUS_LISTENER_DEFINE(central, listener_callback); // NOLINT
```

## include/util.hpp
```c
#pragma once

#include <tl/expected.hpp>

#include "zephyr/kernel.h"
#include <zephyr/zbus/zbus.h>

constexpr std::size_t std_message_queue_size = 10;

template <typename TMessageVariant>
int send_message(const zbus_channel *channel, auto message, k_timeout_t timeout)
{
    TMessageVariant msg = message;
    return zbus_chan_pub(channel, &msg, timeout);
}

template <typename TMessageVariant>
int add_to_queue(const zbus_channel *channel, k_msgq *msg_q,
                 k_timeout_t timeout)
{
    const auto *msg =
        static_cast<const TMessageVariant *>(zbus_chan_const_msg(channel));
    return k_msgq_put(msg_q, msg, timeout);
}

template <typename TMessageVariant>
tl::expected<TMessageVariant, int> msg_get(k_msgq *msgq, k_timeout_t timeout)
{
    TMessageVariant msg{};
    int             ret = k_msgq_get(msgq, &msg, timeout);
    if (ret == 0)
    {
        return msg;
    }

    return tl::make_unexpected(ret);
}

template <typename TMessageVariant, std::size_t queue_size>
class MessageExchange
{
  public:
    explicit MessageExchange(const struct zbus_channel *channel)
        : channel_{channel}
    {
        k_msgq_init(&msgq_, buffer_.data(), sizeof(TMessageVariant),
                    queue_size);
    }

    int send_message(auto message, k_timeout_t timeout)
    {
        TMessageVariant msg = message;
        return zbus_chan_pub(channel_, &msg, timeout);
    }

    int add_to_queue(k_timeout_t timeout)
    {
        const auto *msg =
            static_cast<const TMessageVariant *>(zbus_chan_const_msg(channel_));
        return k_msgq_put(&msgq_, msg, timeout);
    }

    tl::expected<TMessageVariant, int> msg_get(k_timeout_t timeout)
    {
        TMessageVariant msg{};
        int             ret = k_msgq_get(msgq_, &msg, timeout);
        if (ret == 0)
        {
            return msg;
        }

        return tl::make_unexpected(ret);
    }

  private:
    const struct zbus_channel                             *channel_{};
    k_msgq                                                 msgq_{};
    std::array<char, queue_size * sizeof(TMessageVariant)> buffer_;
};
```
