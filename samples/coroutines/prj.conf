## CMakeLists.txt
```
cmake_minimum_required(VERSION 3.20.0)
list(APPEND CMAKE_MODULE_PATH "$ENV{NOTUS_ROOT}/cmake")
include(Util)

ProjectSetup("standard")

find_package(Zephyr REQUIRED HINTS $ENV{ZEPHYR_BASE})
project(coroutine)

set(SOURCES 
    src/main.cpp
    src/scheduler.hpp
    src/scheduler.cpp
    src/task.hpp
)

set_property(SOURCE ${SOURCES} APPEND PROPERTY COMPILE_OPTIONS "-fcoroutines")

target_include_directories(app PRIVATE src)

target_sources(app PRIVATE ${SOURCES})
SetupTarget(app)
```

## prj.conf
```kconfig
CONFIG_DEBUG=y

CONFIG_LOG=y
CONFIG_LOG_MODE_MINIMAL=y

CONFIG_MAIN_STACK_SIZE=4096

CONFIG_NATIVE_SIM_SLOWDOWN_TO_REAL_TIME=y
CONFIG_SYS_CLOCK_TICKS_PER_SEC=32768
```

## src/main.cpp
```c
#include <cstdlib>
#include <iostream>

#include "scheduler.hpp"
#include "task.hpp"

Task<void> foo()
{
    std::cout << "Hello" << '\n';

    co_await SleepTime(1000);

    std::cout << "Goodbye" << '\n';

    co_return;
}


Task<void> foo2()
{
    std::cout << "Hello 2" << '\n';

    co_await SleepTime(1000);

    std::cout << "Goodbye 2" << '\n';

    co_return;
}

int main()
{
    Scheduler scheduler;
    auto      task1 = foo();
    auto      task2 = foo2();
    scheduler.add_routine(&task1);
    scheduler.add_routine(&task2);

    scheduler.run();

    std::exit(0);
}
```

## src/scheduler.hpp
```c
#pragma once

#include <vector>
#include <iostream>
#include <ranges>

#include <uptime_tp.hpp>

#include <task.hpp>

class Scheduler
{
  public:
    void add_routine(Task<void> *task)
    {
        routines.emplace_back(task);
    }

    void run()
    {
        while (true)
        {       
            for (auto *task : routines)
            {
                k_sleep(K_TICKS(1));
                if (task->_handle.promise().runable_time < UpTime::now())
                {
                    if (!task->_handle.done())
                    {
                        task->_handle.resume();
                    }
                }
            }
        }
    }

    friend struct sleep_awaiter;

  private:
    
    std::vector<Task<void> *> routines{};
};
```

## src/task.cpp
```c
#include "task.hpp"


Task::Task(promise_type *promise) : _handle(Handle::from_promise(*promise))
{
}

void Task::resume() const
{
    _handle.resume();
}

Task::~Task()
{
    if (_handle)
    {
        _handle.destroy();
    }
}


void Task::promise_type::unhandled_exception() noexcept
{
}

Task Task::promise_type::get_return_object()
{
    return Task{this};
}

std::suspend_always Task::promise_type::initial_suspend() noexcept
{
    return {};
}

std::suspend_always Task::promise_type::final_suspend() noexcept
{
    return {};
}

void Task::promise_type::return_void() noexcept {};
```

## src/task.hpp
```c
#pragma once

#include <coroutine>
#include <uptime_tp.hpp>

class Scheduler;

struct SleepTime
{
    int time;
};

template <typename ReturnType>
class Task;

template <typename TaskType = Task<void>>
struct task_promise
{
    static void unhandled_exception() noexcept
    {
    }

    TaskType get_return_object()
    {
        return TaskType{std::coroutine_handle<task_promise>::from_promise(*this)};
    }

    static std::suspend_always initial_suspend() noexcept
    {
        return {};
    }

    static std::suspend_always final_suspend() noexcept
    {
        return {};
    }

    void return_void() noexcept
    {
    }

    void sleep(int sleep_time_ms)
    {
        runable_time = UpTime::now() + std::chrono::milliseconds(sleep_time_ms);
    }

    // void return_value(std::string msg) noexcept
    // {
    //     std::cout << " ---- " << std::source_location::current().function_name() << "\n";
    //     _msgOut = std::move(msg);
    // }

    auto await_transform(SleepTime time)
    {
        struct sleep_awaiter
        {
            explicit sleep_awaiter(task_promise *promise, int sleep_time_ms)
                : _promise{promise}, _sleep_time_ms{sleep_time_ms}
            {
            }

            static bool await_ready() noexcept
            {
                return false;
            }

            void await_resume() const noexcept
            {
            }

            void await_suspend(std::coroutine_handle<> /*unused*/) const noexcept
            {
                _promise->sleep(_sleep_time_ms);
            }

            task_promise *_promise;
            int           _sleep_time_ms{};
        };

        return sleep_awaiter{this, time.time};
    }

    std::chrono::time_point<UpTime> runable_time = UpTime::now();
};

template <typename ReturnType = void>
class Task
{
  public:
    using task_type        = Task<ReturnType>;
    using promise_type     = task_promise<task_type>;
    using coroutine_handle = std::coroutine_handle<promise_type>;
    explicit Task(coroutine_handle handle) : _handle{handle}
    {
    }
    ~Task()
    {
        if (_handle)
        {
            _handle.destroy();
        }
    }

    Task(const Task &)            = delete;
    Task &operator=(const Task &) = delete;
    Task(Task &&)                 = delete;
    Task &operator=(Task &&)      = delete;

  private:
    friend class Scheduler;

    coroutine_handle _handle{};
};
```
