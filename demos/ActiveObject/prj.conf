## prj.conf
```kconfig
CONFIG_THREAD_NAME=y

CONFIG_MODULE1=y
```

## src/main.cpp
```c
#include <posix_board_if.h>
#include <zephyr/kernel.h>

#include "module1.hpp"

int main(void)
{

    auto sub1_func_call = mod_1.Create_Sub();
    sub1_func_call.run(5, 6);
    int ret = sub1_func_call.get_return(K_FOREVER);

    printk("%d \n", ret);

    auto print1_func_call = mod_1.Create_Print();
    print1_func_call.run(5);

    k_msleep(5);

    posix_exit(0);
    return 0;
}
```

## src/module1.cpp
```c
#include <zephyr/sys/printk.h>
#include <zephyr/logging/log.h>
#include <zephyr/kernel.h>

#include "module1.hpp"

K_THREAD_STACK_DEFINE(mod_1_stack, CONFIG_MAIN_STACK_SIZE); // NOLINT

Module1 mod_1("Module 1", mod_1_stack, CONFIG_MAIN_STACK_SIZE ,5); // NOLINT

Module1::SubHandler::SubHandler(Future<int> *fut, int a, int b) : BaseHandler(fut), _a{a}, _b{b}
{
}
void Module1::SubHandler::handle()
{
    _fut->_ret = _a - _b;
     
}

Module1::PrintHandler::PrintHandler(int a) : _a{a}
{
}
void  Module1::PrintHandler::handle()
{
    printk("a is %d\n", _a);
}
```
