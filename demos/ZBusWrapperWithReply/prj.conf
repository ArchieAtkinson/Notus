## CMakeLists.txt
```
cmake_minimum_required(VERSION 3.20.0)
list(APPEND CMAKE_MODULE_PATH "$ENV{APPLICATION_ROOT}/cmake")
include(Util)

ProjectSetup("standard")


find_package(Zephyr REQUIRED HINTS $ENV{ZEPHYR_BASE})
project(zbus_observers)

set(SOURCES 
    src/main.cpp
)

target_sources_ifdef(CONFIG_MODULE1 app PRIVATE ${CMAKE_CURRENT_SOURCE_DIR}/src/module1.cpp)
target_sources_ifdef(CONFIG_MODULE2 app PRIVATE ${CMAKE_CURRENT_SOURCE_DIR}/src/module2.cpp)

target_sources(app PRIVATE ${SOURCES})
SetupTarget(app)

target_compile_options(app PUBLIC -Wno-missing-field-initializers)
target_include_directories(app PUBLIC ${CMAKE_CURRENT_SOURCE_DIR}/includes)
```

## prj.conf
```kconfig
CONFIG_ZBUS=y
CONFIG_ZBUS_CHANNEL_NAME=y
CONFIG_ZBUS_OBSERVER_NAME=y
CONFIG_MAIN_THREAD_PRIORITY=5
CONFIG_ZBUS_RUNTIME_OBSERVERS=y
CONFIG_THREAD_NAME=y

CONFIG_MODULE1=y
CONFIG_MODULE2=y
```

## src/main.cpp
```c
#include <string>

#include <zephyr/kernel.h>
#include <zephyr/zbus/zbus.h>
#include <posix_board_if.h>

#include "logging.hpp"
#include "messages.hpp"
#include "pub_sub_with_msgq.hpp"

LOG_MODULE_DECLARE(zbus, CONFIG_ZBUS_LOG_LEVEL);

using SubType = SubscriberWithMsgQ<simple_msg, int>;

ZBUS_CHAN_DEFINE(simple_chan,                                /* Name */
                 SubType,                                    /* Message type */
                 NULL,                                       /* Validator */
                 NULL,                                       /* User data */
                 ZBUS_OBSERVERS_EMPTY,                       /* observers */
                 (SubType()) /* Initial value */
);


int main(void)
{
    PublisherWithMsgQ<simple_msg, std::pair<int, std::string>, 10> producer(&simple_chan);
    producer.send_message({1}, K_FOREVER);
    auto reply1 = producer.get_reply(K_FOREVER).value();
    LOG_INF("Reply: %d, %s", reply1.first, reply1.second.c_str());
    
    auto reply2 = producer.get_reply(K_FOREVER).value();
    LOG_INF("Reply: %d, %s", reply2.first, reply2.second.c_str());

    posix_exit(0);
	return 0;
}
```
