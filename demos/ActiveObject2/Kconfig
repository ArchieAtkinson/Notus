## demos/ActiveObject2/Kconfig
```kconfig
menu "Zephyr Kernel"
    source "Kconfig.zephyr"
endmenu


config MODULE1
	bool "MODULE1"
	help
	  MODULE1
```

## samples/ZBusWrapperWithReply/Kconfig
```kconfig
menu "Zephyr Kernel"
    source "Kconfig.zephyr"
endmenu


config MODULE1
	bool "MODULE1"
	help
	  MODULE1

config MODULE2
	bool "MODULE2"
	help
	  MODULE2

config MODULE3
	bool "MODULE3"
	help
	    MODULE3
```

## samples/zbus_observers/Kconfig
```kconfig
menu "Zephyr Kernel"
    source "Kconfig.zephyr"
endmenu


config LISTENER
	bool "Listener"
	help
	  Listener

config MSG_SUB
	bool "Msg Sub"
	help
	  Msg Sub


config SUB
	bool "Sub"
	help
	    Sub
```

## subsys/Kconfig
```kconfig
menu "Subsystems"

rsource "button/Kconfig"
rsource "file_system/Kconfig"
rsource "stopwatch/Kconfig"
rsource "load_cell/Kconfig"

endmenu
```

## subsys/button/Kconfig
```kconfig
menuconfig BUTTON
	bool "Button Interface"
	select GPIO
	help
        Provides mechanism to handle a range of button inputs

if BUTTON

module = BUTTON
module-str = button
source "subsys/logging/Kconfig.template.log_config"

endif # BUTTON
```

## subsys/file_system/Kconfig
```kconfig
menuconfig FILE_SYSTEM_WRAP
	bool "Wrapper for the file system API"
	select FILE_SYSTEM
	help
        Provides mechanism to handle a range of button inputs

if FILE_SYSTEM_WRAP

module = FILE_SYSTEM_WRAP
module-str = file_system_wrap
source "subsys/logging/Kconfig.template.log_config"

endif # FILE_SYSTEM_WRAP
```

## subsys/load_cell/Kconfig
```kconfig
menuconfig LOAD_CELL
	bool "Load cell"
    select ADC
	help
        Provides a simple load cell API

if LOAD_CELL

module = LOAD_CELL
module-str = load cell
source "subsys/logging/Kconfig.template.log_config"

endif # LOAD_CELL
```

## subsys/stopwatch/Kconfig
```kconfig
menuconfig STOPWATCH
	bool "Stopwatch"
	help
        Provides a simple stopwatch API

if STOPWATCH

module = STOPWATCH
module-str = stopwatch
source "subsys/logging/Kconfig.template.log_config"

endif # STOPWATCH
```

## tests/button/testcase.yaml
```yaml
tests:
  subsy.button:
    platform_allow:
      - native_sim
    integration_platforms:
      - native_sim
```

## tests/cpu_wait/testcase.yaml
```yaml
# Test of the posix_arch k_busy_wait & cpu_hold() functionality
tests:
  boards.native_posix.cpu_wait:
    platform_allow:
      - native_sim
    integration_platforms:
      - native_posix
```

## tests/file_system/testcase.yaml
```yaml
tests:
  app.file_system:
    platform_allow:
      - native_sim
    integration_platforms:
      - native_sim
    skip: true
```

## tests/stopwatch/testcase.yaml
```yaml
tests:
  app.stopwatch:
    platform_allow:
      - native_sim
    integration_platforms:
      - native_sim
```
