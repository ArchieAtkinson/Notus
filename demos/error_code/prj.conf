## prj.conf
```kconfig
CONFIG_GPIO=y

CONFIG_ASSERT=y
```

## src/main.cpp
```c
#include <cstring>
#include <iterator>
#include <zephyr/kernel.h>

#include "flights.hpp"
#include "seats.hpp"
#include "submodule_error.hpp"
#include "queries.hpp"

#include "magic_enum.hpp"

#include <cassert>
#include <iostream>
#include <map>
#include <utility>

std::map<std::pair<std::string, int>, std::string> my_map = 
{
    {std::make_pair("flights", 20), "NoFlightsFound"}
};

   
int main ()
{
  std::error_code ec = FlightsErrc::NoFlightsFound;   
  assert (ec == SubsystemError::NoFlightFound);
  assert (ec != SubsystemError::InputBadClass);
  assert (ec == FailureSource::NoSolution);
  assert (ec != FailureSource::BadUserInput);
  assert (ec == Severity::Normal);
  assert(ec != Severity::Bug);

  std::cout << my_map.at(std::make_pair(ec.category().name(), ec.value())) << std::endl;
      
  ec = SeatsErrc::NonexistentClass;
  assert (ec != SubsystemError::NoFlightFound);
  assert (ec == SubsystemError::InputBadClass);
  assert (ec != FailureSource::NoSolution);
  assert (ec == FailureSource::BadUserInput);
  assert (ec == Severity::Normal);
  assert (ec != Severity::Config);

  std::cout << ec.category().name() << std::endl;
  std::cout << ec.message() << std::endl;
  std::cout << ec.value() << std::endl;
  
 
  // the following illustrates how you insert
  //   raw int values into error_code system:
  int ret_value = 20; // it was returned from Flights
  std::error_code ec2 = static_cast<FlightsErrc>(ret_value);
  std::cout << ec2 << std::endl;
}
  
```

## src/flights2.cpp
```c
#include <cassert>

#include "submodule_error.hpp"

#include "flights2.hpp"
   
namespace { // anonymous namespace
    
struct Flights2ErrCategory : std::error_category
{
  const char* name() const noexcept override;
  std::string message(int ev) const override;
  std::error_condition default_error_condition(int ev) const noexcept override;
};
    
const char* Flights2ErrCategory::name() const noexcept
{
  return "flights2";
}
    
std::string Flights2ErrCategory::message(int ev) const
{
  switch (static_cast<Flights2Errc>(ev))
  {
  // return name for each enum
  default:
    return "(unrecognized error)";
  }
}
 
std::error_condition Flights2ErrCategory::default_error_condition(int ev) const noexcept
{
  switch (static_cast<Flights2Errc>(ev))
  {
  case Flights2Errc::ZeroFlightsFound:
    return SubsystemError::NoFlightFound;
     
  case Flights2Errc::InvalidRequestFormat:
    return SubsystemError::SubsysProtocolErr;
       
  case Flights2Errc::CouldNotConnect:
    return SubsystemError::SubsysConfig;
       
  case Flights2Errc::DatabaseError:
    return SubsystemError::SubsysInternal;
       
  case Flights2Errc::NotEnoughMemory:
    return SubsystemError::SubsysResource;
       
  case Flights2Errc::InternalError:
    return SubsystemError::SubsysInternal;
       
  case Flights2Errc::NoSuchAirport:
    return SubsystemError::InputBadAirport;
       
  case Flights2Errc::JourneyInThePast:
    return SubsystemError::InputPastDate;
       
  case Flights2Errc::DatesNotMonotonic:
    return SubsystemError::InputBadDateRange;
     
  default:
    assert(false);
    return {};
  }
}
    
const Flights2ErrCategory theFlights2ErrCategory {};
    
} // anonymous namespace
   
std::error_code make_error_code(Flights2Errc e)
{
  return {static_cast<int>(e), theFlights2ErrCategory};
}
```

## src/flights2.hpp
```c
#pragma once

#include <system_error>
   
enum class Flights2Errc
{
  ZeroFlightsFound     = 11,
  InvalidRequestFormat = 12,
  CouldNotConnect      = 13,
  DatabaseError        = 14,
  NotEnoughMemory      = 15,
  InternalError        = 16,
  NoSuchAirport        = 17,
  JourneyInThePast     = 18,
  DatesNotMonotonic    = 19,
};
   
namespace std
{
  template <>
    struct is_error_code_enum<Flights2Errc> : true_type {};
}
   
std::error_code make_error_code(Flights2Errc);
```

## src/queries.cpp
```c
#include "submodule_error.hpp"
#include "queries.hpp"
  
namespace {
 
class SubsystemErrorCategory : public std::error_category
{
public:
  const char* name() const noexcept override;
  std::string message(int ev) const override;
};
     
const char* SubsystemErrorCategory::name() const noexcept
{
    return "submodule-error";
}
      
std::string SubsystemErrorCategory::message(int ev) const
{
  switch (static_cast<SubsystemError>(ev))
  {
      default:
          return "(uncharted)";
  }
}
 
const SubsystemErrorCategory theSubsystemErrorCategory {};
 
 
}
 
 
std::error_condition make_error_condition(SubsystemError e)
{
  return {static_cast<int>(e), theSubsystemErrorCategory};
}
 
// -----------------
 
namespace {
class FailureSourceCategory : public std::error_category
{
public:
  const char* name() const noexcept override;
  std::string message(int ev) const override;
  bool equivalent(
      const std::error_code& code,
      int condition) const noexcept override;
};
      
const char* FailureSourceCategory::name() const noexcept
{
    return "failure-source";
}
      
std::string FailureSourceCategory::message(int ev) const
{
  switch (static_cast<FailureSource>(ev))
  {
  case FailureSource::BadUserInput:
    return "invalid user request";
     
  case FailureSource::SystemError:
    return "internal error";
    
  case FailureSource::NoSolution:
    return "no solution found for specified request";
    
  default:
    return "(unrecognized condition)";
  }
}
      
bool FailureSourceCategory::equivalent(
      const std::error_code& ec,
      int cond) const noexcept
{     
  switch (static_cast<FailureSource>(cond))
  {
  case FailureSource::BadUserInput:
    return ec == SubsystemError::InputBadAirport
        || ec == SubsystemError::InputPastDate
        || ec == SubsystemError::InputBadDateRange
        || ec == SubsystemError::InputBadClass;
 
  case FailureSource::SystemError:
    return ec == SubsystemError::SubsysProtocolErr
        || ec == SubsystemError::SubsysInternal
        || ec == SubsystemError::SubsysResource
        || ec == SubsystemError::SubsysConfig        
        || ec == SubsystemError::SubsysTimeout;
         
  case FailureSource::NoSolution:
    return ec == SubsystemError::NoFlightFound
        || ec == SubsystemError::NoSeatFound;
              
  default:
    return false;
  }
}
      
const FailureSourceCategory theFailureSourceCategory {};
    
} // anonymous namespace
   
std::error_condition make_error_condition(FailureSource e)
{
  return {static_cast<int>(e), theFailureSourceCategory};
}
 
// --------------
namespace {
class SeverityCategory : public std::error_category
{
public:
  const char* name() const noexcept override;
  std::string message(int ev) const override;
  bool equivalent(
      const std::error_code& code,
      int condition) const noexcept override;
};
      
const char* SeverityCategory::name() const noexcept
{
    return "severity";
}
      
std::string SeverityCategory::message(int ev) const
{
  switch (static_cast<Severity>(ev))
  {
  case Severity::Bug:
    return "failure is a programmer bug";
     
  case Severity::Config:
    return "failure is a configuration error";
     
  case Severity::Resource:
    return "failure is caused by resource shortage";
   
  case Severity::Normal:
    return "failure requires no attention";  
   
  default:
    return "(unrecognized condition)";
  }
}
      
bool SeverityCategory::equivalent(
      const std::error_code& ec,
      int cond) const noexcept
{     
  switch (static_cast<Severity>(cond))
  {
  case Severity::Bug:
    return ec == SubsystemError::SubsysProtocolErr
        || ec == SubsystemError::SubsysInternal;
         
  case Severity::Config:
    return ec == SubsystemError::SubsysConfig;
 
  case Severity::Resource:
    return ec == SubsystemError::SubsysResource        
        || ec == SubsystemError::SubsysTimeout;
         
  case Severity::Normal:
    return ec == SubsystemError::InputBadAirport
        || ec == SubsystemError::InputPastDate
        || ec == SubsystemError::InputBadDateRange
        || ec == SubsystemError::InputBadClass
        || ec == SubsystemError::NoFlightFound
        || ec == SubsystemError::NoSeatFound;
              
  default:
    return false;
  }
}
      
const SeverityCategory theSeverityCategory {};
    
} // anonymous namespace
   
std::error_condition make_error_condition(Severity e)
{
  return {static_cast<int>(e), theSeverityCategory};
}
```
